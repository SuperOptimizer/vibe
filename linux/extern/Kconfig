## linux/extern/configs/rv_defconfig
```kconfig
BR2_riscv=y
BR2_riscv_custom=y
BR2_RISCV_ISA_RVI=y
BR2_RISCV_ISA_RVM=y
BR2_RISCV_ISA_RVA=y
BR2_RISCV_ISA_RVC=y
BR2_RISCV_32=y
BR2_RISCV_USE_MMU=y
BR2_RISCV_ABI_ILP32=y
BR2_RELRO_NONE=y
BR2_PIC_PIE=n

BR2_LINUX_KERNEL=y
BR2_LINUX_KERNEL_CUSTOM_VERSION=y
BR2_LINUX_KERNEL_CUSTOM_VERSION_VALUE="6.6.9"
BR2_LINUX_KERNEL_VERSION="6.6.9"
BR2_LINUX_KERNEL_USE_CUSTOM_CONFIG=y
BR2_LINUX_KERNEL_CUSTOM_CONFIG_FILE="$(BR2_EXTERNAL_extern_PATH)/Kconfig"

BR2_LINUX_KERNEL_DTS_SUPPORT=y
BR2_LINUX_KERNEL_INTREE_DTS_NAME=""
BR2_LINUX_KERNEL_CUSTOM_DTS_PATH="$(BR2_EXTERNAL_extern_PATH)/vibe.dts"
BR2_LINUX_KERNEL_DTB_KEEP_DIRNAME=y

BR2_TARGET_OPENSBI=y
BR2_TARGET_OPENSBI_LATEST_VERSION=y
BR2_TARGET_OPENSBI_PLAT="generic"
BR2_TARGET_OPENSBI_INSTALL_PAYLOAD_IMG=y
BR2_TARGET_OPENSBI_LINUX_PAYLOAD=y
BR2_TARGET_OPENSBI_ADDITIONAL_VARIABLES="PLATFORM_RISCV_XLEN=32 PLATFORM_RISCV_ISA=rv32imaczicsr_zifencei"

BR2_TARGET_ROOTFS_INITRAMFS=y

BR2_ENABLE_DEBUG=y
BR2_DEBUG_3=y

# Basic networking
BR2_PACKAGE_BUSYBOX_SHOW_OTHERS=y

# Network utilities
BR2_PACKAGE_DROPBEAR=y          # SSH server/client
BR2_PACKAGE_WGET=y              # HTTP client
BR2_PACKAGE_IFUPDOWN_SCRIPTS=y  # Network interface scripts

# Or use systemd-networkd if you prefer:
# BR2_PACKAGE_SYSTEMD_NETWORKD=y

# Network debugging tools
BR2_PACKAGE_TCPDUMP=y
BR2_PACKAGE_ETHTOOL=y
BR2_PACKAGE_IPERF3=y

# Network libraries
BR2_PACKAGE_LIBCURL=y

# Network utilities
BR2_PACKAGE_DROPBEAR=y          # SSH server/client
BR2_PACKAGE_WGET=y              # HTTP client
BR2_PACKAGE_IFUPDOWN_SCRIPTS=y  # Network interface scripts

# Network debugging tools (optional)
BR2_PACKAGE_TCPDUMP=y
BR2_PACKAGE_ETHTOOL=y
BR2_PACKAGE_IPERF3=y
r
# Remove this:
# BR2_PACKAGE_DHCPCD=y

# Add this instead:
BR2_PACKAGE_BUSYBOX_CONFIG_UDHCPC=y
BR2_PACKAGE_BUSYBOX_CONFIG_UDHCP_DEBUG=0

BR2_PACKAGE_STRACE=y

BR2_SYSTEM_DHCP="eth0"

BR2_PACKAGE_IPROUTE2=y
BR2_PACKAGE_OPENSSH=y
BR2_TARGET_ROOTFS_EXT2_4=y
BR2_TARGET_ROOTFS_EXT2=y
```
